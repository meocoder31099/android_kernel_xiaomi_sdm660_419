## block/Kconfig.iosched
```kconfig
# SPDX-License-Identifier: GPL-2.0
if BLOCK

menu "IO Schedulers"

config MQ_IOSCHED_DEADLINE
	tristate "MQ deadline I/O scheduler"
	default y
	---help---
	  MQ version of the deadline IO scheduler.

config MQ_IOSCHED_KYBER
	tristate "Kyber I/O scheduler"
	default y
	---help---
	  The Kyber I/O scheduler is a low-overhead scheduler suitable for
	  multiqueue and other fast devices.
	  Given target latencies for reads and
	  synchronous writes, it will self-tune queue depths to achieve that
	  goal.

config IOSCHED_BFQ
	tristate "BFQ I/O scheduler"
	default n
	---help---
	BFQ I/O scheduler for BLK-MQ.
	BFQ distributes the bandwidth of
	of the device among all processes according to their weights,
	regardless of the device parameters and with any workload.
	It
	also guarantees a low latency to interactive and soft
	real-time applications.
	Details in
	Documentation/block/bfq-iosched.txt

config BFQ_GROUP_IOSCHED
       bool "BFQ hierarchical scheduling support"
       depends on IOSCHED_BFQ && BLK_CGROUP
       default n
       ---help---
       Enable hierarchical scheduling in BFQ, using the blkio
       (cgroups-v1) or io (cgroups-v2) controller.

config IOSCHED_ANXIETY
	tristate "Anxiety I/O scheduler"
	default n
	---help---
	  The Anxiety I/O scheduler prioritizes latency over everything
	  else.
	  When a request comes in, it will use a lighweight
	  selection algorithm to swiftly process the current pending task.

config IOSCHED_ZEN
	tristate "Zen I/O scheduler"
	default n
	---help---
	  The Zen I/O scheduler is an optimization of the No-op and Deadline
	  schedulers, based on historical principles of the Zen kernel.

choice
	prompt "Default mq I/O scheduler"
	default MQ_DEADLINE_DEFAULT
	help
	  Select the I/O scheduler which will be used by default.

	config MQ_DEADLINE_DEFAULT
		bool "MQ Deadline"
		depends on MQ_IOSCHED_DEADLINE

	config MQ_KYBER_DEFAULT
		bool "MQ Kyber"
		depends on MQ_IOSCHED_KYBER

	config BFQ_DEFAULT
		bool "BFQ"
		depends on IOSCHED_BFQ

	config DEFAULT_ANXIETY
		bool "Anxiety"
		depends on IOSCHED_ANXIETY

	config DEFAULT_ZEN
		bool "ZEN"
		depends on IOSCHED_ZEN

endchoice

config DEFAULT_IOSCHED
	string
	default "mq-deadline" if MQ_DEADLINE_DEFAULT
	default "kyber" if MQ_KYBER_DEFAULT
	default "bfq" if BFQ_DEFAULT
	default "anxiety" if DEFAULT_ANXIETY
	default "zen" if DEFAULT_ZEN

endmenu

endif
```
